## hw/rtc/Kconfig
```kconfig
config DS1338
    bool
    depends on I2C
    select DS1338_C if !HAVE_RUST
    select X_DS1338_RUST if HAVE_RUST
    default y if I2C_DEVICES

config DS1338_C
    bool

config M41T80
    bool
    depends on I2C
    default y if I2C_DEVICES

config M48T59
    bool

config PL031
    bool

config MC146818RTC
    depends on ISA_BUS
    bool

config SUN4V_RTC
    bool

config GOLDFISH_RTC
    bool

config LS7A_RTC
    bool

config RS5C372_RTC
    bool
    depends on I2C
    default y if I2C_DEVICES
```

## rust/hw/Kconfig
```kconfig
# devices Kconfig
source char/Kconfig
source gpio/Kconfig
source rtc/Kconfig
source timer/Kconfig
```
